#include "charybdis_cirque.dtsi"

&default_transform {
    col-offset = <3>;
};

&kscan0 {
    diode-direction = "col2row";
    col-gpios
        = <&pro_micro 10 (GPIO_ACTIVE_HIGH)> // COL0 
        , <&pro_micro 16 (GPIO_ACTIVE_HIGH)> // COL1 
        , <&pro_micro 14 (GPIO_ACTIVE_HIGH)> // COL2 
        ;
};

&i2c0 {
    status = "okay";
    trackpad@2a {
	compatible = "cirque,pinnacle";
        status = "okay";
        label = "trackpad";
        reg = <2>;
        dr-gpios = <&pro_micro 4 GPIO_ACTIVE_HIGH>;
	    //rotate-90;
	    //sleep;
	    //no-taps;
    };
};


